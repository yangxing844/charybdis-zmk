/*
 * Copyright (c) 2020 ZMK Contributors
 *
 * SPDX-License-Identifier: MIT
 */

#include "charybdis.dtsi"

#include <input/processors.dtsi>

&kscan0 {
	col-gpios
		= <&pro_micro 19 (GPIO_ACTIVE_HIGH | GPIO_PULL_DOWN)>
		, <&pro_micro 20 (GPIO_ACTIVE_HIGH | GPIO_PULL_DOWN)>
		, <&pro_micro 10 (GPIO_ACTIVE_HIGH | GPIO_PULL_DOWN)>
		, <&pro_micro 16 (GPIO_ACTIVE_HIGH | GPIO_PULL_DOWN)>
		, <&pro_micro 15 (GPIO_ACTIVE_HIGH | GPIO_PULL_DOWN)>
		, <&pro_micro 8 (GPIO_ACTIVE_HIGH | GPIO_PULL_DOWN)>
		;
};

&pmw_listener {
	status = "okay";

	// when layer 2 is active, the trackball will act as a mouse wheel
	scroller {
		layers = <3>;
		input-processors = <&zip_xy_to_scroll_mapper>;
	};
	// default when layer 5 is active, the trackball will move more slowly
		snipe {
		layers =<4>;
		input-processors = <&zip_xy_scaler 1 3>;
	};
	// temp layer when trackball is used, 2 is layer index, and 2000 is the time which the layer will deactivate when no input events is emitted
	input-processors = <&zip_temp_layer 2 2000>;
};
